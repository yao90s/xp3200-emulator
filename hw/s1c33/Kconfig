## hw/s1c33/Kconfig
```kconfig
# SPDX-License-Identifier: GPL-2.0-or-later

config BBK9288S
    bool
    default y
    depends on S1C33

config XP3200
    bool
    default y
    depends on S1C33

config G9001
    bool
    default y
    depends on S1C33
    select SSI
    select SSI_SD
```
